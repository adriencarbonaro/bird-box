## main/Kconfig
```kconfig
menu "Birdbox Settings"

config BIRDBOX_AMPLIFY_GAIN
    int "Default volume (1-10)"
    default 4
    range 1 10

config BIRDBOX_WAV_SERVER_URL
    string "WiFi Server URL (format: http://[IP]:[PORT])"

config BIRDBOX_WIFI_SSID
    string "WiFi SSID"

config BIRDBOX_WIFI_PASSWORD
    string "WiFi Password"

config BIRDBOX_MQTT_URI
    string "MQTT Uri (format: mqtt://[USER]:[PASSWORD]@[HOST]:[PORT])"

config BIRDBOX_MQTT_TOPIC
    string "MQTT topic"

config BIRDBOX_MQTT_MSG_PLAY
    string "MQTT message to indicate play"

config BIRDBOX_MQTT_MSG_PAUSE
    string "MQTT message to indicate pause"

endmenu
```

## main/Kconfig.projbuild
```kconfig
menu "Birdbox Settings"

config BIRDBOX_AMPLIFY_GAIN
    int "Default volume (1-10)"
    default 1
    range 1 10

# Audio server configuration ---------------------------------------------------

config BIRDBOX_MP3_SERVER_URL
    string "Audio Server URL (format: http://[IP]:[PORT])"

# HA identity configuration -----------------------------------------------------------

config DEVICE_ID
    string "The Home Assistant device ID (lowercase)"
    default "bird_box"

config DEVICE_NAME
    string "The Home Assistant device name"
    default "Bird Box"

config MANUFACTURER
    string "The Home Assistant manufacturer name"
    default "Carbonaro"

config MODEL
    string "The Home Assistant model name"
    default "ESP32"

endmenu
```
